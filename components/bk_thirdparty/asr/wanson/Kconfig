## components/bk_thirdparty/asr/wanson/Kconfig
```kconfig
menu "Bk_thirdparty::Wanson"

	config WANSON_ASR
		bool "Enable Wanson ASR"
		default n
		help
			Enable Wanson Automatic Speech Recognition

	config WANSON_ASR_GROUP_VERSION
		bool "Enable Wanson ASR_GROUP_VERSION"
		default n
		help
			Enable Wanson ASR_GROUP_VERSION

	choice WANSON_ASR_WORDS_VERSION
		depends on WANSON_ASR
		prompt "Select Words Version"
		default WANSON_ASR_GROUP_VERSION_WORDS_V1

		config WANSON_ASR_WORDS_VERSION_V1
		bool "Enable Words Version V1"
		help
			support wakeword "a er mi nuo"

		config WANSON_ASR_WORDS_VERSION_V2
		bool "Enable Words Version V2"
		help
			support wakeword "hi armino"

		config WANSON_ASR_WORDS_VERSION_V3
		bool "Enable Words Version V3"
		help
			support wakeword "xiaoding xiaoding"

		config WANSON_ASR_GROUP_VERSION_WORDS_V1
		bool "Enable Wanson ASR Group Version_V1"
		help
			support wakeword "hi armino"

		config WANSON_ASR_GROUP_VERSION_WORDS_V2
		bool "Enable Wanson ASR Group Version_V2"
		help
			support wakeword "nihao armino"


	endchoice

endmenu
```

## components/display_service/Kconfig
```kconfig
menu "Display Service"

	config MEDIA_DISPLAY_SERVICE
		depends on SYS_CPU1
        depends on MEDIA
		bool "Enable Display Service"
		default y

	config LCD_SPI_DISPLAY
		depends on SPI
		bool "Enable LCD SPI Display"
		default n

	config LCD_SPI_TE
		bool "Enable LCD SPI TE"
		default n

	config LCD_EXAMPLE
		depends on SPI
		bool "Enable LCD SPI Display"
		default n

	config LCD_TE_ENABLE
		bool "Enable te gpio check function for mcu8080 lcd"
		default n
endmenu
```

## projects/media/doorbell_no_psram/main/Kconfig.projbuild
```kconfig
menu "INTEGRATION_DOORBELL"

    config INTEGRATION_DOORBELL
        bool "Doorbell integration"
        default n
    config INTEGRATION_DOORBELL_CS2
        bool "Doorbell integration CS2"
        default n

    config LCD_SPI_REFRESH_WITH_QSPI_MAPPING_MODE
        bool "Enabel LCD SPI refresh with qspi mapping mode "
        default n

    config LCD_SPI_BACKLIGHT_PIN
        int "Set LCD SPI backlight pin"
        default 43

    config LCD_SPI_RESET_PIN
        int "Set LCD SPI reset pin"
        default 40

    config LCD_SPI_DC_PIN
        int "Set LCD SPI DC pin"
        default 25

    config LCD_SPI_TE_PIN
        int "Set LCD SPI TE pin"
        default 6

    config LCD_BACKLIGHT_GPIO
        int "Set LCD QSPI backlight pin"
        default 43

    config LCD_QSPI_RESET_PIN
        int "Set LCD QSPI reset pin"
        default 40

    config LCD_QSPI_TE_PIN
        int "Set LCD QSPI TE pin"
        default 6
endmenu
```
